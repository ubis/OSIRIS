## buildroot/package/dspaudio/Config.in
```kconfig
config BR2_PACKAGE_DSPAUDIO
	bool "dspaudio"
	help
	  The DSP firmware that dspd runs (services/dspaudio). It needs
	  the C6000 toolchain, so "make dspaudio" at the top of the
	  repository builds it before Buildroot runs; this package
	  installs the image, and the decoder's dspaudio.ddr with it.
```

## buildroot/package/dspd/Config.in
```kconfig
config BR2_PACKAGE_DSPD
	bool "dspd"
	depends on !BR2_PREFER_STATIC_LIB
	select BR2_PACKAGE_UBUS
	help
	  Runs the DSP firmware (dspaudio) and sets its volume and
	  routing over the ubus (services/dspd).
```

## buildroot/package/shairport-sync/Config.in
```kconfig
config BR2_PACKAGE_SHAIRPORT_SYNC
	bool "shairport-sync"
	depends on BR2_TOOLCHAIN_HAS_THREADS
	select BR2_PACKAGE_OPENSSL
	select BR2_PACKAGE_POPT
	select BR2_PACKAGE_LIBCONFIG
	help
	  AirPlay audio player. OSIRIS plays its output on the NET input
	  through pcmd.

	  https://github.com/mikebrady/shairport-sync
```

## buildroot/package/ubus/Config.in
```kconfig
config BR2_PACKAGE_UBUS
	bool "ubus"
	depends on !BR2_PREFER_STATIC_LIB
	select BR2_PACKAGE_LIBUBOX
	select BR2_PACKAGE_JSON_C
	help
	  OpenWrt's micro bus architecture: the ubusd message bus
	  daemon, the libubus client library and the ubus command
	  line tool.

	  https://git.openwrt.org/project/ubus.git

comment "ubus needs a toolchain w/ dynamic library"
	depends on BR2_PREFER_STATIC_LIB
```

## external/Config.in
```kconfig
menu "OSIRIS"
source "$BR2_EXTERNAL_OSIRIS_PATH/package/jsonfilter/Config.in"
source "$BR2_EXTERNAL_OSIRIS_PATH/package/mcud/Config.in"
source "$BR2_EXTERNAL_OSIRIS_PATH/package/dspd/Config.in"
source "$BR2_EXTERNAL_OSIRIS_PATH/package/dspaudio/Config.in"
source "$BR2_EXTERNAL_OSIRIS_PATH/package/osirisd/Config.in"
source "$BR2_EXTERNAL_OSIRIS_PATH/package/pcmd/Config.in"
source "$BR2_EXTERNAL_OSIRIS_PATH/package/procd/Config.in"
source "$BR2_EXTERNAL_OSIRIS_PATH/package/ubox/Config.in"
source "$BR2_EXTERNAL_OSIRIS_PATH/package/ubus-luajit/Config.in"
source "$BR2_EXTERNAL_OSIRIS_PATH/package/udebug/Config.in"
endmenu
```

## external/board/onkyo/nr/kernel.its
```
/* U-Boot boots the configuration named in "board", else the default */
/dts-v1/;
/ {
	description = "Linux OSIRIS @VERSION@";
	#address-cells = <1>;
	images {
		kernel {
			description = "Linux";
			data = /incbin/("@IMAGES@/zImage");
			type = "kernel_noload";
			arch = "arm";
			os = "linux";
			compression = "none";
			load = <0>;
			entry = <0>;
		};
		fdt-onkyo-nr {
			description = "Onkyo DA830/OMAP-L137 DSP board";
			data = /incbin/("@IMAGES@/da830-onkyo-nr.dtb");
			type = "flat_dt";
			arch = "arm";
			compression = "none";
		};
		fdt-tx-nr515 {
			description = "Onkyo TX-NR515";
			data = /incbin/("@IMAGES@/da830-onkyo-tx-nr515.dtb");
			type = "flat_dt";
			arch = "arm";
			compression = "none";
		};
		fdt-tx-nr717 {
			description = "Onkyo TX-NR717";
			data = /incbin/("@IMAGES@/da830-onkyo-tx-nr717.dtb");
			type = "flat_dt";
			arch = "arm";
			compression = "none";
		};
	};
	configurations {
		default = "onkyo-nr";
		onkyo-nr {
			kernel = "kernel";
			fdt = "fdt-onkyo-nr";
		};
		tx-nr515 {
			kernel = "kernel";
			fdt = "fdt-tx-nr515";
		};
		tx-nr717 {
			kernel = "kernel";
			fdt = "fdt-tx-nr717";
		};
	};
};
```

## external/board/onkyo/nr/linux/arch/arm/configs/onkyo_nr_defconfig
```kconfig
CONFIG_KERNEL_LZ4=y
CONFIG_SYSVIPC=y
# CONFIG_CROSS_MEMORY_ATTACH is not set
CONFIG_NO_HZ_IDLE=y
CONFIG_HIGH_RES_TIMERS=y
CONFIG_PREEMPT=y
CONFIG_IKCONFIG=y
CONFIG_IKCONFIG_PROC=y
CONFIG_LOG_BUF_SHIFT=15
CONFIG_BLK_DEV_INITRD=y
# CONFIG_RD_BZIP2 is not set
# CONFIG_RD_LZMA is not set
# CONFIG_RD_XZ is not set
# CONFIG_RD_LZO is not set
# CONFIG_RD_LZ4 is not set
# CONFIG_RD_ZSTD is not set
CONFIG_CC_OPTIMIZE_FOR_SIZE=y
CONFIG_EXPERT=y
# CONFIG_FHANDLE is not set
# CONFIG_AIO is not set
# CONFIG_IO_URING is not set
# CONFIG_ARCH_MULTI_V7 is not set
CONFIG_ARCH_DAVINCI=y
CONFIG_ARCH_DAVINCI_DA830=y
CONFIG_AEABI=y
CONFIG_UACCESS_WITH_MEMCPY=y
CONFIG_ARM_APPENDED_DTB=y
CONFIG_ARM_ATAG_DTB_COMPAT=y
# CONFIG_SUSPEND is not set
CONFIG_PM=y
CONFIG_MODULES=y
CONFIG_MODULE_UNLOAD=y
# CONFIG_COREDUMP is not set
# CONFIG_SWAP is not set
# CONFIG_COMPAT_BRK is not set
CONFIG_NET=y
CONFIG_PACKET=y
CONFIG_UNIX=y
CONFIG_INET=y
CONFIG_IP_PNP=y
# CONFIG_INET_DIAG is not set
# CONFIG_IPV6 is not set
# CONFIG_ETHTOOL_NETLINK is not set
CONFIG_DEVTMPFS=y
CONFIG_DEVTMPFS_MOUNT=y
# CONFIG_FW_LOADER is not set
CONFIG_MTD=y
CONFIG_MTD_BLOCK=y
CONFIG_MTD_RAW_NAND=y
CONFIG_MTD_NAND_DAVINCI=y
CONFIG_MTD_UBI=y
CONFIG_MTD_UBI_GLUEBI=y
CONFIG_SCSI=y
# CONFIG_SCSI_PROC_FS is not set
CONFIG_BLK_DEV_SD=y
# CONFIG_BLK_DEV_BSG is not set
CONFIG_NETDEVICES=y
CONFIG_TI_DAVINCI_EMAC=y
CONFIG_MICREL_PHY=y
# CONFIG_WLAN is not set
# CONFIG_INPUT is not set
# CONFIG_SERIO is not set
# CONFIG_VT is not set
# CONFIG_LEGACY_PTYS is not set
CONFIG_SERIAL_8250=y
CONFIG_SERIAL_8250_CONSOLE=y
CONFIG_SERIAL_8250_NR_UARTS=3
CONFIG_SERIAL_8250_RUNTIME_UARTS=3
CONFIG_SERIAL_OF_PLATFORM=y
# CONFIG_HW_RANDOM is not set
CONFIG_SPI=y
CONFIG_SPI_DAVINCI=y
CONFIG_SPI_SPIDEV=y
CONFIG_GPIOLIB=y
# CONFIG_HWMON is not set
CONFIG_WATCHDOG=y
CONFIG_DAVINCI_WATCHDOG=y
CONFIG_REGULATOR=y
CONFIG_REGULATOR_FIXED_VOLTAGE=y
CONFIG_USB=y
CONFIG_USB_OHCI_HCD=y
CONFIG_USB_STORAGE=y
CONFIG_USB_MUSB_HDRC=y
CONFIG_USB_MUSB_DA8XX=y
CONFIG_USB_TI_CPPI41_DMA=y
CONFIG_NOP_USB_XCEIV=y
CONFIG_DMADEVICES=y
CONFIG_MEMORY=y
CONFIG_TI_AEMIF=y
# CONFIG_DNOTIFY is not set
CONFIG_VFAT_FS=y
CONFIG_TMPFS=y
CONFIG_UBIFS_FS=y
# CONFIG_UBIFS_FS_XATTR is not set
CONFIG_SQUASHFS=y
# CONFIG_SQUASHFS_ZLIB is not set
CONFIG_SQUASHFS_LZ4=y
CONFIG_NLS_CODEPAGE_437=y
CONFIG_NLS_ISO8859_1=y
CONFIG_NLS_UTF8=y
CONFIG_PRINTK_TIME=y
# CONFIG_DEBUG_BUGVERBOSE is not set
# CONFIG_SLUB_DEBUG is not set
CONFIG_PANIC_TIMEOUT=5
```

## external/board/onkyo/nr/u-boot/board/onkyo/nr/Kconfig
```kconfig
if TARGET_ONKYO_NR

config SYS_BOARD
	default "nr"

config SYS_VENDOR
	default "onkyo"

config SYS_CONFIG_NAME
	default "onkyo_nr"

endif
```

## external/board/onkyo/nr/u-boot/configs/onkyo_nr_defconfig
```kconfig
CONFIG_ARM=y
CONFIG_SKIP_LOWLEVEL_INIT=y
CONFIG_SYS_THUMB_BUILD=y
CONFIG_ARCH_DAVINCI=y
CONFIG_TEXT_BASE=0xc1080000
CONFIG_SYS_MALLOC_LEN=0x220000
CONFIG_SYS_MALLOC_F_LEN=0x800
CONFIG_TARGET_ONKYO_NR=y
CONFIG_NR_DRAM_BANKS=1
CONFIG_HAS_CUSTOM_SYS_INIT_SP_ADDR=y
CONFIG_CUSTOM_SYS_INIT_SP_ADDR=0xc0f00000
CONFIG_ENV_SIZE=0x4000
CONFIG_ENV_OFFSET=0x0
CONFIG_DEFAULT_DEVICE_TREE="da830-onkyo-nr"
CONFIG_SYS_LOAD_ADDR=0xc0700000
CONFIG_ENV_OFFSET_REDUND=0x100000
CONFIG_HAS_BOARD_SIZE_LIMIT=y
CONFIG_BOARD_SIZE_LIMIT=524224
CONFIG_STACK_SIZE=0x100000
CONFIG_DYNAMIC_SYS_CLK_FREQ=y
CONFIG_FIT=y
CONFIG_BOOTDELAY=1
CONFIG_OF_BOARD_SETUP=y
CONFIG_FDT_FIXUP_PARTITIONS=y
CONFIG_USE_BOOTCOMMAND=y
CONFIG_BOOTCOMMAND="ubi part ubi; if test \"x${upgrade_slot}\" != x; then setenv slot ${upgrade_slot}; setenv upgrade_slot; saveenv; echo Trying upgraded slot ${slot}; run bootslot_one; fi; setenv slot ${bootslot}; run bootslot_one; if test \"${bootslot}\" = b; then setenv slot a; else setenv slot b; fi; echo Slot ${bootslot} failed, trying slot ${slot}; run bootslot_one"
CONFIG_BOARD_EARLY_INIT_F=y
CONFIG_HUSH_PARSER=y
# CONFIG_BOOTM_PLAN9 is not set
# CONFIG_BOOTM_RTEMS is not set
# CONFIG_BOOTM_VXWORKS is not set
# CONFIG_CMD_ELF is not set
# CONFIG_CMD_FDT is not set
# CONFIG_CMD_XIMG is not set
# CONFIG_CMD_RANDOM is not set
CONFIG_CMD_MEMTEST=y
# CONFIG_CMD_LOADS is not set
CONFIG_CMD_NAND=y
CONFIG_CMD_DHCP=y
CONFIG_CMD_MII=y
CONFIG_CMD_PING=y
CONFIG_CMD_MTDPARTS=y
CONFIG_CMD_UBI=y
# CONFIG_CMD_UBIFS is not set
CONFIG_OF_CONTROL=y
CONFIG_ENV_IS_IN_NAND=y
CONFIG_ENV_REDUNDANT=y
CONFIG_ENV_RELOC_GD_ENV_ADDR=y
CONFIG_NET_RETRY_COUNT=10
CONFIG_NET_RANDOM_ETHADDR=y
# CONFIG_MMC is not set
CONFIG_MTD=y
CONFIG_DM_MTD=y
CONFIG_SYS_MTDPARTS_RUNTIME=y
CONFIG_MTD_RAW_NAND=y
CONFIG_SYS_NAND_USE_FLASH_BBT=y
CONFIG_NAND_DAVINCI=y
CONFIG_SYS_NAND_DA8XX_RBL=y
CONFIG_MTD_UBI_FASTMAP=y
CONFIG_MII=y
CONFIG_DRIVER_TI_EMAC=y
CONFIG_DRIVER_TI_EMAC_USE_RMII=y
CONFIG_DM_SERIAL=y
CONFIG_SYS_NS16550=y
```

## external/configs/onkyo_nr_defconfig
```kconfig
BR2_arm=y
BR2_TOOLCHAIN_BUILDROOT_UCLIBC=y
BR2_KERNEL_HEADERS_6_18=y
BR2_TOOLCHAIN_BUILDROOT_WCHAR=y
BR2_TOOLCHAIN_BUILDROOT_CXX=y
BR2_DL_DIR="$(BR2_EXTERNAL_OSIRIS_PATH)/../dl"
BR2_GLOBAL_PATCH_DIR="$(BR2_EXTERNAL_OSIRIS_PATH)/patches"
BR2_TARGET_GENERIC_HOSTNAME="ONKYO"
BR2_TARGET_GENERIC_ISSUE="OSIRIS"
BR2_ROOTFS_DEVICE_CREATION_DYNAMIC_MDEV=y
BR2_TARGET_GENERIC_GETTY_PORT="ttyS1"
BR2_TARGET_GENERIC_GETTY_BAUDRATE_115200=y
# BR2_TARGET_GENERIC_REMOUNT_ROOTFS_RW is not set
BR2_ROOTFS_OVERLAY="$(BR2_EXTERNAL_OSIRIS_PATH)/board/onkyo/nr/rootfs-overlay"
BR2_ROOTFS_POST_BUILD_SCRIPT="$(BR2_EXTERNAL_OSIRIS_PATH)/board/onkyo/nr/post-build.sh"
BR2_ROOTFS_POST_FAKEROOT_SCRIPT="$(BR2_EXTERNAL_OSIRIS_PATH)/board/onkyo/nr/post-fakeroot.sh"
BR2_ROOTFS_POST_IMAGE_SCRIPT="$(BR2_EXTERNAL_OSIRIS_PATH)/board/onkyo/nr/post-image.sh"
BR2_LINUX_KERNEL=y
BR2_LINUX_KERNEL_CUSTOM_VERSION=y
BR2_LINUX_KERNEL_CUSTOM_VERSION_VALUE="6.18.57"
BR2_LINUX_KERNEL_PATCH="$(BR2_EXTERNAL_OSIRIS_PATH)/board/onkyo/nr/linux-patches"
BR2_LINUX_KERNEL_DEFCONFIG="onkyo_nr"
BR2_LINUX_KERNEL_DTS_SUPPORT=y
BR2_LINUX_KERNEL_INTREE_DTS_NAME="ti/davinci/da830-onkyo-nr"
BR2_PACKAGE_BUSYBOX_CONFIG_FRAGMENT_FILES="$(BR2_EXTERNAL_OSIRIS_PATH)/board/onkyo/nr/busybox.fragment"
BR2_PACKAGE_MTD=y
BR2_PACKAGE_UBOOT_TOOLS=y
BR2_PACKAGE_UBOOT_TOOLS_MKENVIMAGE=y
BR2_PACKAGE_LUAJIT=y
BR2_PACKAGE_DROPBEAR=y
BR2_PACKAGE_SHAIRPORT_SYNC=y
BR2_TARGET_ROOTFS_CPIO=y
BR2_TARGET_ROOTFS_SQUASHFS=y
BR2_TARGET_ROOTFS_SQUASHFS4_XZ=y
# BR2_TARGET_ROOTFS_TAR is not set
BR2_TARGET_UBOOT=y
BR2_TARGET_UBOOT_BUILD_SYSTEM_KCONFIG=y
BR2_TARGET_UBOOT_CUSTOM_VERSION=y
BR2_TARGET_UBOOT_CUSTOM_VERSION_VALUE="2026.07"
BR2_TARGET_UBOOT_PATCH="$(BR2_EXTERNAL_OSIRIS_PATH)/board/onkyo/nr/u-boot-patches"
BR2_TARGET_UBOOT_BOARD_DEFCONFIG="onkyo_nr"
BR2_PACKAGE_HOST_UBOOT_TOOLS=y
BR2_PACKAGE_MCUD=y
BR2_PACKAGE_DSPD=y
BR2_PACKAGE_DSPAUDIO=y
BR2_PACKAGE_OSIRISD=y
BR2_PACKAGE_PCMD=y
```

## external/configs/toolchain_arm926t_musl_defconfig
```kconfig
BR2_arm=y
BR2_TOOLCHAIN_BUILDROOT_MUSL=y
BR2_KERNEL_HEADERS_6_18=y
BR2_GCC_VERSION_15_X=y
BR2_TOOLCHAIN_BUILDROOT_CXX=y
BR2_DL_DIR="$(BR2_EXTERNAL_OSIRIS_PATH)/../dl"
BR2_INIT_NONE=y
BR2_SYSTEM_BIN_SH_NONE=y
# BR2_PACKAGE_BUSYBOX is not set
# BR2_TARGET_ROOTFS_TAR is not set
```

## external/package/dspd/Config.in
```kconfig
config BR2_PACKAGE_DSPD
	bool "dspd"
	depends on !BR2_STATIC_LIBS
	select BR2_PACKAGE_UBUS
	help
	  Runs the DSP firmware (dspaudio) and sets its volume and
	  routing over the ubus (services/dspd).
```

## external/package/jsonfilter/Config.in
```kconfig
config BR2_PACKAGE_JSONFILTER
	bool "jsonfilter"
	depends on BR2_TOOLCHAIN_HAS_SYNC_4 # json-c
	depends on !BR2_STATIC_LIBS # libubox
	select BR2_PACKAGE_JSON_C
	select BR2_PACKAGE_LIBUBOX
	help
	  OpenWrt's JSON query tool, which procd's shell functions use
	  to ask about services.

	  https://git.openwrt.org/project/jsonpath.git
```

## external/package/mcud/Config.in
```kconfig
config BR2_PACKAGE_MCUD
	bool "mcud"
	depends on !BR2_STATIC_LIBS
	select BR2_PACKAGE_UBUS
	help
	  The link to the receiver's main MCU on the ubus: the SPI
	  protocol, the start-up handshake and events for everything
	  the MCU reports (services/mcud).
```

## external/package/osirisd/Config.in
```kconfig
config BR2_PACKAGE_OSIRISD
	bool "osirisd"
	depends on BR2_PACKAGE_LUAJIT
	select BR2_PACKAGE_UBUS
	select BR2_PACKAGE_UBUS_LUAJIT
	select BR2_PACKAGE_JSONFILTER # netupdate
	select BR2_PACKAGE_UCLIENT # netupdate
	select BR2_PACKAGE_USIGN # netupdate
	help
	  The receiver's policy in Lua: it listens to the events mcud
	  reports and tells dspd and the system what to do
	  (services/osirisd).

comment "osirisd needs LuaJIT"
	depends on !BR2_PACKAGE_LUAJIT
```

## external/package/pcmd/Config.in
```kconfig
config BR2_PACKAGE_PCMD
	bool "pcmd"
	help
	  Plays audio from Linux on the DSP's NET input: PCM from a pipe,
	  resampled to 48 kHz, into the ring the DSP reads
	  (services/pcmd).
```

## external/package/procd/Config.in
```kconfig
config BR2_PACKAGE_PROCD
	bool "procd"
	depends on BR2_INIT_NONE
	depends on BR2_TOOLCHAIN_HAS_SYNC_4 # ubus
	depends on !BR2_STATIC_LIBS # ubus
	select BR2_PACKAGE_JSON_C
	select BR2_PACKAGE_JSONFILTER # procd.sh
	select BR2_PACKAGE_LIBUBOX
	select BR2_PACKAGE_UBOX # logd
	select BR2_PACKAGE_UBUS
	select BR2_PACKAGE_UDEBUG
	help
	  OpenWrt's init and service manager: preinit, hotplug from the
	  kernel's uevents, services that procd starts, watches and
	  restarts, and the system watchdog. Without ujail, uxc and the
	  seccomp tools, so no uci, and without kmodloader. OpenWrt's
	  rc.common, procd.sh and hotplug rules come with it.

	  https://git.openwrt.org/project/procd.git
```

## external/package/ubox/Config.in
```kconfig
config BR2_PACKAGE_UBOX
	bool "ubox"
	depends on BR2_TOOLCHAIN_HAS_SYNC_4 # ubus
	depends on !BR2_STATIC_LIBS # ubus
	select BR2_PACKAGE_UBUS
	select BR2_PACKAGE_UDEBUG # logd
	help
	  logd and logread from OpenWrt's ubox: the system log in a RAM
	  ring buffer, kernel messages included, read and followed over
	  ubus. Also kmodloader, which procd's init runs, as insmod,
	  rmmod, lsmod, modinfo and modprobe.

	  https://git.openwrt.org/project/ubox.git
```

## external/package/ubus-luajit/Config.in
```kconfig
config BR2_PACKAGE_UBUS_LUAJIT
	bool "ubus-luajit"
	depends on BR2_PACKAGE_LUAJIT
	depends on BR2_TOOLCHAIN_HAS_SYNC_4 # ubus
	depends on !BR2_STATIC_LIBS # ubus
	select BR2_PACKAGE_UBUS
	help
	  The ubus and uloop Lua modules of ubus and libubox, built for
	  LuaJIT; Buildroot builds them only for Lua 5.1. osirisd uses
	  them.

comment "ubus-luajit needs LuaJIT"
	depends on !BR2_PACKAGE_LUAJIT
```

## external/package/uclient/Config.in
```kconfig
config BR2_PACKAGE_UCLIENT
	bool "uclient"
	depends on BR2_TOOLCHAIN_HAS_SYNC_4 # json-c
	depends on !BR2_STATIC_LIBS # libubox, dlopen
	select BR2_PACKAGE_LIBUBOX
	select BR2_PACKAGE_USTREAM_SSL # https
	select BR2_PACKAGE_CA_CERTIFICATES # https
	help
	  OpenWrt's HTTP client library and uclient-fetch, a small wget
	  that does HTTPS through ustream-ssl.

	  https://git.openwrt.org/project/uclient.git
```

## external/package/udebug/Config.in
```kconfig
config BR2_PACKAGE_UDEBUG
	bool "udebug"
	depends on BR2_TOOLCHAIN_HAS_SYNC_4 # ubus
	depends on !BR2_STATIC_LIBS # ubus
	select BR2_PACKAGE_UBUS
	help
	  The library of OpenWrt's udebug, debug ring buffers over ubus,
	  which logd links against.

	  https://git.openwrt.org/project/udebug.git
```

## external/package/umdns/Config.in
```kconfig
config BR2_PACKAGE_UMDNS
	bool "umdns"
	depends on BR2_TOOLCHAIN_HAS_SYNC_4 # ubus
	depends on !BR2_STATIC_LIBS # ubus
	select BR2_PACKAGE_UBUS
	select BR2_PACKAGE_UDEBUG
	select BR2_PACKAGE_JSON_C
	help
	  OpenWrt's mDNS responder: announces services described in
	  /etc/umdns/*.json and browses for others over ubus.

	  https://git.openwrt.org/project/mdnsd.git
```

## external/package/usign/Config.in
```kconfig
config BR2_PACKAGE_USIGN
	bool "usign"
	depends on BR2_TOOLCHAIN_HAS_SYNC_4 # json-c
	depends on !BR2_STATIC_LIBS # libubox
	select BR2_PACKAGE_LIBUBOX
	help
	  OpenWrt's ed25519 signing tool, which checks that an update
	  is signed with the release key.

	  https://git.openwrt.org/project/usign.git
```

## linux/drivers/char/gpiodev/Kconfig
```kconfig
#
# GPIO device driver configuration
#

config GPIODEV
	tristate "GPIO character device support"
	depends on GPIOLIB && ARCH_DAVINCI
	default y
	help
	  This driver provides a character device interface (/dev/gpiodev)
	  for controlling GPIO pins on OMAP-L137/DA830 SoC.

	  The device supports ioctl-based GPIO control for setting and
	  reading GPIO pin values.

	  To compile this driver as a module, choose M here: the module
	  will be called gpiodev.
```
